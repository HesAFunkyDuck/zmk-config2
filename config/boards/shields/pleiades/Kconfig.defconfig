## config/boards/shields/pleiades/Kconfig.defconfig
```kconfig
if SHIELD_PLEIADES_LEFT

config ZMK_KEYBOARD_NAME
	default "Pleiades"

config ZMK_SPLIT_ROLE_CENTRAL
	default y

endif

if SHIELD_PLEIADES_LEFT || SHIELD_PLEIADES_RIGHT

config ZMK_SPLIT
    default y

endif
```

## config/boards/shields/pleiades/Kconfig.shield
```kconfig
config SHIELD_PLEIADES_LEFT
    def_bool $(shields_list_contains,pleiades_left)

config SHIELD_PLEIADES_RIGHT
    def_bool $(shields_list_contains,pleiades_right)
```
